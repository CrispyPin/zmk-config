## config/boards/shields/leko_pona/Kconfig.defconfig
```kconfig
if SHIELD_LEKO_PONA_LEFT

config ZMK_KEYBOARD_NAME
    default "leko pona wan"

config ZMK_SPLIT_ROLE_CENTRAL
    default y

endif

if SHIELD_LEKO_PONA_LEFT || SHIELD_LEKO_PONA_RIGHT

config ZMK_SPLIT
    default y

endif
```

## config/boards/shields/leko_pona/Kconfig.shield
```kconfig
config SHIELD_LEKO_PONA_LEFT
    def_bool $(shields_list_contains,leko_pona_left)

config SHIELD_LEKO_PONA_RIGHT
    def_bool $(shields_list_contains,leko_pona_right)
```
